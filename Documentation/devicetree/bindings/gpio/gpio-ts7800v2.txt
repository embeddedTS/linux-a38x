## Documentation/devicetree/bindings/gpio/gpio-ts7800v2.txt
```
* embeddedTS TS-7800-V2 FPGA GPIO controller bindings

This bindings describes the GPIO controller for embeddedTS's TS-7800-v2 FPGA
core.

Required properties:
- compatible: Should be
                "technologic,ts7800v2-gpio"
```
